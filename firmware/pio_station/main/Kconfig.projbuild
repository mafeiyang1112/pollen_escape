## firmware/pio_station/main/Kconfig.projbuild
```kconfig
menu "Pollen Escape PlatformIO Station"

    config ESP_WIFI_SSID
        string "WiFi SSID"
        default "feiyang"

    config ESP_WIFI_PASSWORD
        string "WiFi Password"
        default "12345678"

    config ESP_MAXIMUM_RETRY
        int "Maximum WiFi retry"
        range 1 100
        default 10

    config SENSOR_POST_URL
        string "Sensor POST URL"
        default "https://btaknzxzeczz.sealoshzh.site/data"

    config SENSOR_DEVICE_ID
        string "Device ID"
        default "esp32-s3-real-001"

    config SENSOR_AO_GPIO
        int "GP2Y1023 AO GPIO"
        range 1 20
        default 14

    config SENSOR_SAMPLE_PERIOD_MS
        int "Sensor sample period (ms)"
        range 50 60000
        default 250

    config SENSOR_POST_INTERVAL_SEC
        int "Sensor upload interval (sec)"
        range 1 3600
        default 5

    config SENSOR_CLEAN_AIR_MV
        int "Clean-air baseline (mV)"
        range 0 3300
        default 500

    config SENSOR_DENSE_AIR_MV
        int "Dense-air reference (mV)"
        range 1 3300
        default 2200

    config SENSOR_SCORE_MAX
        int "Max uploaded score"
        range 10 1000
        default 120

    config SENSOR_OUTPUT_INVERTED
        bool "Invert AO mapping"
        default n
        help
            Enable this if the measured voltage goes down as dust concentration rises.

    config SENSOR_WARNING_THRESHOLD
        int "Warning threshold"
        range 0 1000
        default 50

    config SENSOR_ALARM_THRESHOLD
        int "Alarm threshold"
        range 0 1000
        default 85

    config I2S_BCLK_GPIO
        int "MAX98357A BCLK GPIO"
        range 0 48
        default 5

    config I2S_WS_GPIO
        int "MAX98357A LRC/WS GPIO"
        range 0 48
        default 4

    config I2S_DOUT_GPIO
        int "MAX98357A DIN GPIO"
        range 0 48
        default 18

    config ALARM_TONE_WARNING_HZ
        int "Warning tone frequency"
        range 100 5000
        default 760

    config ALARM_TONE_ALARM_HZ
        int "Alarm tone frequency"
        range 100 5000
        default 980

    config ALARM_WARNING_BEEP_MS
        int "Warning beep duration (ms)"
        range 10 5000
        default 170

    config ALARM_ALARM_BEEP_MS
        int "Alarm beep duration (ms)"
        range 10 5000
        default 260

    config ALARM_SOUND_ENABLED
        bool "Alarm sound enabled"
        default y
        help
            Disable this to mute all warning/alarm tones on the device.

endmenu
```

## firmware/pio_station/sdkconfig.defaults
```kconfig
CONFIG_ESP_MAXIMUM_RETRY=10
CONFIG_SENSOR_POST_URL="http://10.104.85.85:5000/data"
CONFIG_SENSOR_DEVICE_ID="esp32-s3-real-001"
CONFIG_SENSOR_AO_GPIO=14
CONFIG_SENSOR_SAMPLE_PERIOD_MS=250
CONFIG_SENSOR_POST_INTERVAL_SEC=2
# Calibration adjusted so 600mV -> 60 points with 5mV per point.
CONFIG_SENSOR_CLEAN_AIR_MV=300
CONFIG_SENSOR_DENSE_AIR_MV=700
CONFIG_SENSOR_SCORE_MAX=120
CONFIG_SENSOR_OUTPUT_INVERTED=n
CONFIG_SENSOR_WARNING_THRESHOLD=50
CONFIG_SENSOR_ALARM_THRESHOLD=85
CONFIG_I2S_BCLK_GPIO=5
CONFIG_I2S_WS_GPIO=4
CONFIG_I2S_DOUT_GPIO=18
CONFIG_I2S_SUPPRESS_DEPRECATE_WARN=y
CONFIG_ALARM_TONE_WARNING_HZ=760
CONFIG_ALARM_TONE_ALARM_HZ=980
CONFIG_ALARM_WARNING_BEEP_MS=170
CONFIG_ALARM_ALARM_BEEP_MS=260
CONFIG_ALARM_SOUND_ENABLED=y
CONFIG_ESPTOOLPY_FLASHSIZE_16MB=y
CONFIG_ESPTOOLPY_FLASHSIZE="16MB"
CONFIG_PARTITION_TABLE_CUSTOM=y
CONFIG_PARTITION_TABLE_FILENAME="partitions.csv"
```

## firmware/station/main/Kconfig.projbuild
```kconfig
menu "Example Configuration"

    config ESP_WIFI_SSID
        string "WiFi SSID"
        default "myssid"
        help
            SSID (network name) for the example to connect to.

    config ESP_WIFI_PASSWORD
        string "WiFi Password"
        default "mypassword"
        help
            WiFi password (WPA or WPA2) for the example to use.

    choice ESP_WIFI_SAE_MODE
        prompt "WPA3 SAE mode selection"
        default ESP_WPA3_SAE_PWE_BOTH
        help
            Select mode for SAE as Hunt and Peck, H2E or both.
        config ESP_WPA3_SAE_PWE_HUNT_AND_PECK
            bool "HUNT AND PECK"
        config ESP_WPA3_SAE_PWE_HASH_TO_ELEMENT
            bool "H2E"
        config ESP_WPA3_SAE_PWE_BOTH
            bool "BOTH"
    endchoice

    config ESP_WIFI_PW_ID
        string "PASSWORD IDENTIFIER"
        depends on  ESP_WPA3_SAE_PWE_HASH_TO_ELEMENT|| ESP_WPA3_SAE_PWE_BOTH
        default ""
        help
            password identifier for SAE H2E

    config ESP_MAXIMUM_RETRY
        int "Maximum retry"
        default 5
        help
            Set the Maximum retry to avoid station reconnecting to the AP unlimited when the AP is really inexistent.

    config SENSOR_POST_URL
        string "Sensor POST URL"
        default "http://10.180.226.69:5000/data"
        help
            Flask backend URL for sensor data POST requests.

    config SENSOR_POST_MIN_INTERVAL_SEC
        int "Sensor POST min interval (seconds)"
        range 1 3600
        default 5
        help
            Minimum delay between two sensor uploads.

    config SENSOR_POST_MAX_INTERVAL_SEC
        int "Sensor POST max interval (seconds)"
        range 1 3600
        default 10
        help
            Maximum delay between two sensor uploads.

    choice ESP_WIFI_SCAN_AUTH_MODE_THRESHOLD
        prompt "WiFi Scan auth mode threshold"
        default ESP_WIFI_AUTH_WPA2_PSK
        help
            The weakest authmode to accept in the scan mode.
            This value defaults to ESP_WIFI_AUTH_WPA2_PSK incase password is present and ESP_WIFI_AUTH_OPEN is used.
            Please select ESP_WIFI_AUTH_WEP/ESP_WIFI_AUTH_WPA_PSK incase AP is operating in WEP/WPA mode.

        config ESP_WIFI_AUTH_OPEN
            bool "OPEN"
        config ESP_WIFI_AUTH_WEP
            bool "WEP"
        config ESP_WIFI_AUTH_WPA_PSK
            bool "WPA PSK"
        config ESP_WIFI_AUTH_WPA2_PSK
            bool "WPA2 PSK"
        config ESP_WIFI_AUTH_WPA_WPA2_PSK
            bool "WPA/WPA2 PSK"
        config ESP_WIFI_AUTH_WPA3_PSK
            bool "WPA3 PSK"
        config ESP_WIFI_AUTH_WPA2_WPA3_PSK
            bool "WPA2/WPA3 PSK"
        config ESP_WIFI_AUTH_WAPI_PSK
            bool "WAPI PSK"
    endchoice

endmenu
```
